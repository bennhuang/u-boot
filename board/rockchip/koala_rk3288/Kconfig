## board/rockchip/koala_rk3288/Kconfig
```kconfig
if TARGET_KOALA_RK3288

config SYS_BOARD
	default "koala_rk3288"

config SYS_VENDOR
	default "rockchip"

config SYS_CONFIG_NAME
	default "koala_rk3288"

config BOARD_SPECIFIC_OPTIONS # dummy
	def_bool y

endif
```

## board/rockchip/twys_rk3288/Kconfig
```kconfig
if TARGET_TWYS_RK3288

config SYS_BOARD
	default "twys_rk3288"

config SYS_VENDOR
	default "rockchip"

config SYS_CONFIG_NAME
	default "twys_rk3288"

config BOARD_SPECIFIC_OPTIONS # dummy
	def_bool y

endif
```
